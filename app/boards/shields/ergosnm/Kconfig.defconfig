## app/boards/shields/ergosnm/Kconfig.defconfig
```kconfig
if SHIELD_ERGOSNM_RIGHT

config ZMK_KEYBOARD_NAME
	default "ErgoSNM v3"

config ZMK_SPLIT_BLE_ROLE_CENTRAL
	default y

endif

if SHIELD_ERGOSNM_LEFT || SHIELD_ERGOSNM_RIGHT

config ZMK_SPLIT
	default y
	
endif

config MOUSE_LAYER_INDEX
	int "Index of mouse layer"
	default 4

config SCROLL_LAYER_INDEX
	int "Index of scroll layer"
	default 5

config MOUSE_LAYER_ACTIVE_MS
	int "Amount of milliseconds the mouse layer will be active after using the trackball"
	default 400
```

## app/boards/shields/ergosnm/Kconfig.shield
```kconfig
config SHIELD_ERGOSNM_LEFT
	def_bool $(shields_list_contains,ergosnm_left)

config SHIELD_ERGOSNM_RIGHT
	def_bool $(shields_list_contains,ergosnm_right)
```

## app/drivers/sensor/paw3395/Kconfig
```kconfig
# Sensor data simulator
#
# Copyright (c) 2019 Nordic Semiconductor
#
# SPDX-License-Identifier: LicenseRef-Nordic-5-Clause
#

menuconfig PAW3395
	bool "PAW3395 mouse optical sensor"
	help
	  Enable PAW3395 mouse optical sensor.

if PAW3395

config PAW3395_CPI
	int "PAW3395's default CPI"
	default 1600
	range 100 12000
	help
	  Default CPI value.

config PAW3395_CPI_DIVIDOR
	int "PAW3395's default CPI dividor"
	default 4
	range 1 12
	help
	  Default CPI dividor value.

config PAW3395_RUN_DOWNSHIFT_TIME_MS
	int "PAW3395's default RUN mode downshift time"
	default 500
	range 10 2550
	help
	  Default RUN mode downshift down time in milliseconds.
	  Time after which sensor goes from RUN to REST1 mode.

config PAW3395_REST1_DOWNSHIFT_TIME_MS
	int "PAW3395's default REST1 mode downshift time"
	default 9220
	range 320 81600
	help
	  Default REST1 mode downshift down time in milliseconds.
	  Time after which sensor goes from REST1 to REST2 mode.

config PAW3395_REST2_DOWNSHIFT_TIME_MS
	int "PAW3395's default REST2 mode downshift time"
	default 150000
	range 3200 816000
	help
	  Default REST2 mode downshift down time in milliseconds.
	  Time after which sensor goes from REST2 to REST3 mode.

choice
	prompt "Select PAW3395 sensor orientation"
	default PAW3395_ORIENTATION_0

config PAW3395_ORIENTATION_0
	bool "PAW3395 not rotated"

config PAW3395_ORIENTATION_90
	bool "PAW3395 rotated 90 deg clockwise"

config PAW3395_ORIENTATION_180
	bool "PAW3395 rotated 180 deg clockwise"

config PAW3395_ORIENTATION_270
	bool "PAW3395 rotated 270 deg clockwise"

endchoice

module = PAW3395
module-str = PAW3395
source "${ZEPHYR_BASE}/subsys/logging/Kconfig.template.log_config"

endif #PAW3395
```

## app/src/point_device/Kconfig
```kconfig
# Copyright (c) 2021 The ZMK Contributors
# SPDX-License-Identifier: MIT

menuconfig ZMK_POINT_DEVICE
    bool "Enable ZMK general point device support"
    default n

if ZMK_POINT_DEVICE

choice ZMK_PD_WORK_QUEUE
    prompt "Work queue used to process point device events"

config ZMK_PD_WORK_QUEUE_DEDICATED
    bool "Use dedicated work queue for point device events"

config ZMK_PD_WORK_QUEUE_SYSTEM
    bool "Use default system work queue for point device events"
endchoice

if ZMK_PD_WORK_QUEUE_DEDICATED

config ZMK_PD_DEDICATED_WORK_QUEUE_STACK_SIZE
    int "Stack size for dedicated point device thread/queue"
    default 2048

config ZMK_PD_DEDICATED_WORK_QUEUE_PRIORITY
    int "Thread priority for dedicated point device thread/queue"
    default 2

endif # ZMK_PD_WORK_QUEUE_DEDICATED

choice ZMK_PD_SEND_THREAD
    prompt "Thread used to send mouse report"

config ZMK_PD_SEND_THREAD_DEDICATED
    bool "Use dedicated thread to send mouse report"

config ZMK_PD_SEND_THREAD_SHARED
    bool "Use default zmk work queue to send mouse report"
endchoice

if ZMK_PD_SEND_THREAD_DEDICATED

config ZMK_PD_DEDICATED_SEND_THREAD_STACK_SIZE
    int "Stack size for dedicated point device sending thread"
    default 2048

config ZMK_PD_DEDICATED_SEND_THREAD_PRIORITY
    int "Thread priority for dedicated point device sending thread"
    default -1

endif # ZMK_PD_SEND_THREAD_DEDICATED

endif # ZMK_POINT_DEVICE
```
