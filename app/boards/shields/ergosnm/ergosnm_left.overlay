/*
 * Copyright (c) 2020 ZMK Contributors
 *
 * SPDX-License-Identifier: MIT
 */

#include "ergosnm.dtsi"

&kscan0 {
	col-gpios
		= <&gpio0 10 (GPIO_ACTIVE_HIGH | GPIO_PULL_DOWN)>
		, <&gpio0  9 (GPIO_ACTIVE_HIGH | GPIO_PULL_DOWN)>
		, <&gpio1 11 (GPIO_ACTIVE_HIGH | GPIO_PULL_DOWN)>
		, <&gpio1 10 (GPIO_ACTIVE_HIGH | GPIO_PULL_DOWN)>
		, <&gpio0  3 (GPIO_ACTIVE_HIGH | GPIO_PULL_DOWN)>
		, <&gpio0 28 (GPIO_ACTIVE_HIGH | GPIO_PULL_DOWN)>
		, <&gpio1 04 (GPIO_ACTIVE_HIGH | GPIO_PULL_DOWN)>
		, <&gpio0 13 (GPIO_ACTIVE_HIGH | GPIO_PULL_DOWN)>
		;

	row-gpios
		= <&gpio0 30 GPIO_ACTIVE_HIGH>
		, <&gpio0 31 GPIO_ACTIVE_HIGH>
		, <&gpio0 29 GPIO_ACTIVE_HIGH>
		, <&gpio0  2 GPIO_ACTIVE_HIGH>
		, <&gpio1 13 GPIO_ACTIVE_HIGH>
		, <&gpio1  9 GPIO_ACTIVE_HIGH>
		;
};