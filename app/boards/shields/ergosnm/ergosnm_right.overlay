/*
 * Copyright (c) 2020 ZMK Contributors
 *
 * SPDX-License-Identifier: MIT
 */

#include "ergosnm.dtsi"

&default_transform {
	col-offset = <8>;
};

&kscan0 {
	col-gpios
	= <&gpio0  9 (GPIO_ACTIVE_HIGH | GPIO_PULL_DOWN)>
	, <&gpio1 13 (GPIO_ACTIVE_HIGH | GPIO_PULL_DOWN)>
	, <&gpio0  2 (GPIO_ACTIVE_HIGH | GPIO_PULL_DOWN)>
	, <&gpio0 30 (GPIO_ACTIVE_HIGH | GPIO_PULL_DOWN)>
	, <&gpio0 31 (GPIO_ACTIVE_HIGH | GPIO_PULL_DOWN)>
	, <&gpio0 29 (GPIO_ACTIVE_HIGH | GPIO_PULL_DOWN)>
	// , <&gpio0 26 (GPIO_ACTIVE_HIGH | GPIO_PULL_DOWN)>
	;

	row-gpios
	= <&gpio0 10 GPIO_ACTIVE_HIGH>
	, <&gpio0 28 GPIO_ACTIVE_HIGH>
	, <&gpio0  3 GPIO_ACTIVE_HIGH>
	, <&gpio1 10 GPIO_ACTIVE_HIGH>
	, <&gpio1 11 GPIO_ACTIVE_HIGH>
	, <&gpio0 24 GPIO_ACTIVE_HIGH>
	;
};

// &pinctrl {
// 	spi0_default_alt: spi0_default_alt{
// 		group1{
// 			psels = <NRF_PSEL(SPIM_SCK, 0, 13)>,
// 			        <NRF_PSEL(SPIM_MOSI, 1, 9)>,
// 			        <NRF_PSEL(SPIM_MISO, 0, 5)>;
// 		};
// 	};

// 	spi0_sleep_alt: spi0_sleep_alt{
// 		group1{
// 			psels = <NRF_PSEL(SPIM_SCK, 0, 13)>,
// 			        <NRF_PSEL(SPIM_MOSI, 1, 9)>,
// 			        <NRF_PSEL(SPIM_MISO, 0, 5)>;
// 			low-power-enable;
// 		};
// 	};
// };

// trackball bus
&spi0 {
	status = "okay"; //okay
	sck-pin = <13>;
	mosi-pin = <41>; // P1.09 ,32 + 9
	miso-pin = <41>; // same as mosi (3-wire spi)
	cs-gpios = <&gpio1 6 GPIO_ACTIVE_LOW>;
};

&trackball {
	status = "okay"; //okay
	irq-gpios = <&gpio1 4 (GPIO_ACTIVE_LOW | GPIO_PULL_UP)>;
};
